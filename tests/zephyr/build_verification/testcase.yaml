## tests/zephyr/build_verification/testcase.yaml
```yaml
common:
  tags:
    - crypto
    - cryptoauthlib
  depends_on: i2c

tests:
  libraries.crypto.cryptoauthlib.build_i2c:
    platform_allow:
      - native_sim
      - qemu_cortex_m3
    extra_configs:
      - CONFIG_CRYPTOAUTHLIB=y
      - CONFIG_ATCA_HAL_I2C=y
      - CONFIG_ATCA_ATECC608_SUPPORT=y
      - CONFIG_ATCA_NO_HEAP=y
    tags:
      - cryptoauthlib
      - i2c

  libraries.crypto.cryptoauthlib.build_defaults:
    platform_allow:
      - native_sim
      - qemu_cortex_m3
    extra_configs:
      - CONFIG_CRYPTOAUTHLIB=y
    tags:
      - cryptoauthlib
```

## zephyr/Kconfig
```kconfig
menuconfig CRYPTOAUTHLIB
	bool "CryptoAuthLib - Microchip CryptoAuthentication Library"
	help
	  Enable the Microchip CryptoAuthLib module for communicating
	  with CryptoAuthentication secure elements (ATECC608, ECC204,
	  SHA104/105, TA010, etc.) over I2C or SPI.

if CRYPTOAUTHLIB

menu "Hardware Abstraction Layer (HAL)"

config ATCA_HAL_I2C
	bool "I2C HAL driver"
	default y
	depends on I2C
	help
	  Use the I2C HAL for device communication.

config ATCA_HAL_SPI
	bool "SPI HAL driver"
	depends on SPI
	help
	  Use the SPI HAL for device communication.

config ATCA_HAL_CUSTOM
	bool "Custom/plug-in HAL driver"
	help
	  Build support for a custom HAL implementation.

config ATCA_HAL_KIT_HID
	bool "Kit protocol HID HAL driver"
	help
	  Include the HID-based kit protocol driver.

config ATCA_HAL_KIT_BRIDGE
	bool "Kit bridge protocol"
	help
	  Include the general-purpose kit bridge protocol.

config ATCA_HAL_KIT_UART
	bool "Kit protocol UART HAL driver"
	help
	  Include the UART-based kit protocol driver.

config ATCA_HAL_SWI_UART
	bool "SWI over UART HAL driver"
	help
	  Include the single-wire interface over UART driver.

endmenu # HAL

menu "Library Behavior"

config ATCA_PRINTF
	bool "Debug printf statements"
	help
	  Turn on internal debug output in the library.

config ATCA_NO_HEAP
	bool "Disable dynamic heap allocation"
	default y
	help
	  Do not use malloc/free; use only stack/static allocations.

config ATCA_CHECK_PARAMS_EN
	bool "Parameter checking"
	default y
	help
	  Check input parameters in public APIs for safety.

config ATCA_ENABLE_DEPRECATED
	bool "Deprecated APIs"
	help
	  Allow use of older API wrappers that have been replaced.

config ATCA_STRICT_C99
	bool "Strict C99 compliance"
	help
	  Compile with strict C99 rules (-Wpedantic).

config MULTIPART_BUF_EN
	bool "Multipart buffer support"
	help
	  Support large multipart buffers in CryptoAuthLib.

endmenu # Library Behavior

menu "Cryptographic Backends"

config ATCA_MBEDTLS
	bool "mbedTLS integration"
	help
	  Use mbedTLS as the cryptographic backend.

config ATCA_WOLFSSL
	bool "wolfSSL integration"
	help
	  Use wolfSSL as the cryptographic backend.

config ATCA_OPENSSL
	bool "OpenSSL integration"
	help
	  Use OpenSSL as the cryptographic backend.

endmenu # Cryptographic Backends

menu "Certificates and JWT"

config ATCA_JWT_EN
	bool "JWT functionality"
	help
	  Build in support for JSON Web Tokens.

config ATCACERT_COMPCERT_EN
	bool "Compressed certificate support"
	default y

config ATCACERT_FULLSTOREDCERT_EN
	bool "Full stored certificate support"
	default y

menu "Trust Platform (TNG) Certificates"

config ATCA_TNGTLS_SUPPORT
	bool "Trust & Go TLS certificates"

config ATCA_TNGLORA_SUPPORT
	bool "Trust & Go LoRa certificates"

config ATCA_TFLEX_SUPPORT
	bool "TrustFlex certificates"

config ATCA_TNG_LEGACY_SUPPORT
	bool "Legacy Trust & Go certificates"

endmenu # TNG

config ATCA_WPC_SUPPORT
	bool "WPC certificates"

endmenu # Certificates and JWT

menu "SHA Support"

config ATCAC_SHA384_EN
	bool "SHA-384"

config ATCAC_SHA512_EN
	bool "SHA-512"

endmenu # SHA Support

menu "PKCS#11"

config ATCA_PKCS11
	bool "PKCS#11 interface"
	help
	  Build the PKCS#11 interface library.

endmenu # PKCS#11

menu "Device Support"

config ATCA_ATSHA204A_SUPPORT
	bool "ATSHA204A"
	default y

config ATCA_ATSHA206A_SUPPORT
	bool "ATSHA206A"
	default y

config ATCA_ATECC108A_SUPPORT
	bool "ATECC108A"
	default y

config ATCA_ATECC508A_SUPPORT
	bool "ATECC508A"
	default y

config ATCA_ATECC608_SUPPORT
	bool "ATECC608"
	default y

config ATCA_ECC204_SUPPORT
	bool "ECC204"
	default y

config ATCA_TA010_SUPPORT
	bool "TA010"
	default y

config ATCA_SHA104_SUPPORT
	bool "SHA104"
	default y

config ATCA_SHA105_SUPPORT
	bool "SHA105"
	default y

endmenu # Device Support

endif # CRYPTOAUTHLIB
```
